## diagnostics/jc1060p470c_camera_probe/components/guition_ov02c10/Kconfig
```kconfig
menuconfig CAMERA_OV02C10
    bool "Guition OV02C10"
    default y
    depends on SOC_MIPI_CSI_SUPPORTED
    help
        Enable the OV02C10 driver pinned from the JC1060P470C-I-W-Y vendor demo.

if CAMERA_OV02C10
    config CAMERA_OV02C10_AUTO_DETECT_MIPI_INTERFACE_SENSOR
        bool "Detect OV02C10 on MIPI CSI"
        default y

    config CAMERA_OV02C10_MIPI_RAW10_1288X728_30FPS
        bool "MIPI 1-lane, 24 MHz input, 1288x728 30 fps, RAW10"
        default y

    config CAMERA_OV02C10_MIPI_DEFAULT_FMT_RAW10_1288X728_30FPS
        bool
        default y
        depends on CAMERA_OV02C10_MIPI_RAW10_1288X728_30FPS

    config CAMERA_OV02C10_MIPI_IF_FORMAT_INDEX_DEFAULT
        int
        default 0

    config CAMERA_OV02C10_ABSOLUTE_GAIN_LIMIT
        int
        default 66016
        range 4000 126016

    choice CAMERA_OV02C10_ABS_GAIN_MAP_PRIORITY
        prompt "OV02C10 gain control priority"
        default CAMERA_OV02C10_DIG_GAIN_PRIORITY

        config CAMERA_OV02C10_ANA_GAIN_PRIORITY
            bool "Analog gain priority"

        config CAMERA_OV02C10_DIG_GAIN_PRIORITY
            bool "Digital gain priority"
    endchoice
endif
```

## diagnostics/jc1060p470c_camera_probe/sdkconfig.defaults
```kconfig
CONFIG_IDF_TARGET_ESP32P4=y
CONFIG_ESPTOOLPY_FLASHSIZE_16MB=y
CONFIG_PARTITION_TABLE_SINGLE_APP_LARGE=y

# JC1060P470C-I-W-Y boards use ESP32-P4 revisions below v3.0.
CONFIG_ESP32P4_SELECTS_REV_LESS_V3=y
CONFIG_ESP32P4_REV_MIN_100=y

# JC1060P470C-I-W-Y manufacturer demo memory configuration.
CONFIG_SPIRAM=y
CONFIG_SPIRAM_MODE_HEX=y
CONFIG_SPIRAM_SPEED_200M=y
CONFIG_SPIRAM_USE_MALLOC=y
CONFIG_SPIRAM_MALLOC_ALWAYSINTERNAL=4096
CONFIG_SPIRAM_MALLOC_RESERVE_INTERNAL=32768

# Only the manufacturer-proven OV02C10 MIPI mode is enabled.
CONFIG_CAMERA_OV02C10=y
CONFIG_CAMERA_OV02C10_AUTO_DETECT_MIPI_INTERFACE_SENSOR=y
CONFIG_CAMERA_OV02C10_MIPI_RAW10_1288X728_30FPS=y
CONFIG_CAMERA_OV02C10_MIPI_DEFAULT_FMT_RAW10_1288X728_30FPS=y
CONFIG_CAMERA_OV02C10_MIPI_IF_FORMAT_INDEX_DEFAULT=0

CONFIG_ESP_VIDEO_CHECK_PARAMETERS=y
CONFIG_ESP_VIDEO_ENABLE_MIPI_CSI_VIDEO_DEVICE=y
CONFIG_ESP_VIDEO_DISABLE_MIPI_CSI_DRIVER_BACKUP_BUFFER=y
# CONFIG_ESP_VIDEO_ENABLE_ISP is not set
# CONFIG_ESP_VIDEO_ENABLE_ISP_VIDEO_DEVICE is not set
# CONFIG_ESP_VIDEO_ENABLE_ISP_PIPELINE_CONTROLLER is not set
```
